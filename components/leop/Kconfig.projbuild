## components/leop/Kconfig.projbuild
```kconfig
menu "LEOP Server"

    config LEOP_SERVER_URL
        string "LEOP_SERVER_URL"
        help
            URL where leop server API can be reached. (Raw IP addresses need the http:// prefix to work properly.)

    config LEOP_SERVER_PORT
        string "LEOP_SERVER_PORT"
        help
            Port on URL where leop server API can be reached.

    config LEOP_SERVER_FACILITY_NAME
        string "LEOP_SERVER_FACILITY_NAME"
        help
            Name of facility on the LEOP server where data should be fetched from.

    config LEOP_DATA_RETRIEVAL_FREQUENCY
        int "LEOP_DATA_RETRIEVAL_FREQUENCY"
        range 1 60
        default 15
        help
            How often the LEOP-data should get fetched in minutes.

endmenu
```

## components/wifi/Kconfig.projbuild
```kconfig
menu "Wifi Credentials"

    config WIFI_CREDENTIAL_SSID
        string "SSID"
        help
            SSID of target WiFi network.

    config WIFI_CREDENTIAL_PASSPHRASE
        string "Passphrase"
        help
            Passphrase of target WiFi network.

endmenu
```

## sdkconfig.defaults
```kconfig
CONFIG_IDF_TARGET="esp32s3"
CONFIG_ESPTOOLPY_FLASHSIZE_16MB=y
CONFIG_PARTITION_TABLE_CUSTOM=y
CONFIG_PARTITION_TABLE_CUSTOM_FILENAME="partitions.csv"

CONFIG_SPIRAM=y
CONFIG_SPIRAM_MODE_OCT=y
CONFIG_SPIRAM_SPEED_80M=y
CONFIG_SPIRAM_SPEED=80
CONFIG_SPIRAM_USE_MALLOC=y
CONFIG_SPIRAM_MALLOC_ALWAYSINTERNAL=16384
CONFIG_SPIRAM_RODATA=n
CONFIG_SPIRAM_FETCH_INSTRUCTIONS=n
CONFIG_ESP32S3_SPIRAM_SUPPORT=y

CONFIG_ESP_DEFAULT_CPU_FREQ_MHZ_240=y
CONFIG_ESP_MAIN_TASK_STACK_SIZE=8192
CONFIG_FREERTOS_USE_TRACE_FACILITY=y

CONFIG_LOG_DEFAULT_LEVEL_INFO=y
#CONFIG_LOG_DEFAULT_LEVEL_DEBUG=n
CONFIG_I2C_ENABLE_DEBUG_LOG=y
CONFIG_LCD_ENABLE_DEBUG_LOG=y

CONFIG_ESP_TASK_WDT_EN=y
CONFIG_ESP_TASK_WDT_INIT=y
CONFIG_ESP_TASK_WDT_TIMEOUT_S=5
# FreeRTOS tick rate (improves timer precision)
CONFIG_FREERTOS_HZ=1000

# LVGL OS integration
CONFIG_LV_OS_FREERTOS=y

# Use standard C library functions
CONFIG_LV_USE_CLIB_MALLOC=y
CONFIG_LV_USE_CLIB_STRING=y
CONFIG_LV_USE_CLIB_SPRINTF=y

# Display refresh rate (in milliseconds, 15ms ≈ 66 FPS)
CONFIG_LV_DEF_REFR_PERIOD=15

# Enable style caching for better performance
CONFIG_LV_OBJ_STYLE_CACHE=y

# Try this for multicore
# CONFIG_LV_DRAW_SW_DRAW_UNIT_CNT=2
```
